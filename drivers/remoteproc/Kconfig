## drivers/remoteproc/Kconfig
```kconfig
menu "Remoteproc drivers (EXPERIMENTAL)"

# REMOTEPROC gets selected by whoever wants it
config REMOTEPROC
	tristate
	depends on EXPERIMENTAL
	depends on HAS_DMA
	select CRC32
	select FW_LOADER
	select VIRTIO
	select VIRTUALIZATION

config DUMMY_REMOTEPROC
	tristate "Dummy remoteproc support"
	select REMOTEPROC
	select RPMSG
	select DUMMY_RESOURCETABLE
	help
	  Say y here to enable support for a dummy remote processor driver
	  via the remote processor framework.

config DUMMY_RESOURCETABLE
	tristate "Dummy remoteproc's driver resource table"

endmenu
```
